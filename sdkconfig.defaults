## sdkconfig.defaults
```kconfig
CONFIG_PARTITION_TABLE_CUSTOM=y

CONFIG_ESPTOOLPY_FLASHMODE_QIO=y
CONFIG_ESPTOOLPY_FLASHFREQ_80M=y

CONFIG_ESP_CONSOLE_UART_CUSTOM=y

CONFIG_FREERTOS_HZ=1000

CONFIG_LWIP_MAX_SOCKETS=16

CONFIG_ENABLE_MDNS=y

CONFIG_NEWLIB_NANO_FORMAT=y

CONFIG_LOG_DEFAULT_LEVEL_ERROR=y
CONFIG_LOG_BOOTLOADER_LEVEL_ERROR=y
CONFIG_LOG_SET_LEVEL=y

CONFIG_ESP_PHY_CALIBRATION_AND_DATA_STORAGE=n

CONFIG_MBEDTLS_DYNAMIC_BUFFER=y
CONFIG_MBEDTLS_DYNAMIC_FREE_PEER_CERT=y
CONFIG_MBEDTLS_DYNAMIC_FREE_CONFIG_DATA=y

CONFIG_LWIP_ESP_LWIP_ASSERT=n
CONFIG_ESP_TASK_WDT=y
CONFIG_ESP_TASK_WDT_TIMEOUT_S=30
CONFIG_ESP_TASK_WDT_PANIC=y
```

## sdkconfig.defaults.esp32
```kconfig
CONFIG_COMPILER_OPTIMIZATION_PERF=y

CONFIG_PARTITION_TABLE_CUSTOM_FILENAME="partitions.esp32.csv"

CONFIG_ESPTOOLPY_FLASHSIZE_4MB=y

CONFIG_ESP32_DEFAULT_CPU_FREQ_240=y
CONFIG_ESP32_DEFAULT_CPU_FREQ_MHZ=240


CONFIG_ESP32_WIFI_STATIC_RX_BUFFER_NUM=25
CONFIG_ESP32_WIFI_DYNAMIC_RX_BUFFER_NUM=64
CONFIG_ESP32_WIFI_DYNAMIC_TX_BUFFER_NUM=64
CONFIG_ESP32_WIFI_AMPDU_TX_ENABLED=y
CONFIG_ESP32_WIFI_TX_BA_WIN=32
CONFIG_ESP32_WIFI_AMPDU_RX_ENABLED=y
CONFIG_ESP32_WIFI_RX_BA_WIN=32
CONFIG_ESP32_WIFI_NVS_ENABLED=n

CONFIG_MBEDTLS_DYNAMIC_FREE_CONFIG_CA_CERT=y

CONFIG_LWIP_TCP_MSL=5000
CONFIG_LWIP_MAX_ACTIVE_TCP=24
CONFIG_LWIP_TCP_SND_BUF_DEFAULT=65535
CONFIG_LWIP_TCP_WND_DEFAULT=65535
CONFIG_LWIP_TCP_RECVMBOX_SIZE=64
CONFIG_LWIP_UDP_RECVMBOX_SIZE=64
CONFIG_LWIP_TCPIP_RECVMBOX_SIZE=64
CONFIG_LWIP_IRAM_OPTIMIZATION=y
CONFIG_LWIP_TCPIP_TASK_AFFINITY_CPU1=y

CONFIG_ESP_NETIF_HOSTNAME_MAX_LENGTH=64

CONFIG_ESP_SYSTEM_PANIC_PRINT_REBOOT=y

CONFIG_ESP_NETIF_TCPIP_ADAPTER_COMPATIBLE_LAYER=y

CONFIG_ESP_CONSOLE_SECONDARY_NONE=y

CONFIG_SPI_MASTER_IN_IRAM=y

CONFIG_ESP_MAIN_TASK_AFFINITY_CPU1=y

CONFIG_MDNS_TASK_AFFINITY_NO_AFFINITY=y
```

## sdkconfig.defaults.esp8266
```kconfig
CONFIG_COMPILER_OPTIMIZATION_LEVEL_RELEASE=y

CONFIG_PARTITION_TABLE_CUSTOM_FILENAME="partitions.esp8266.csv"

CONFIG_ESPTOOLPY_FLASHSIZE_4MB=y

CONFIG_SOC_FULL_ICACHE=y
CONFIG_ESP_PHY_INIT_DATA_VDD33_CONST=255
CONFIG_ESP8266_DEFAULT_CPU_FREQ_160=y
CONFIG_ESP8266_WIFI_CONNECT_OPEN_ROUTER_WHEN_PWD_IS_SET=n
CONFIG_ESP8266_WIFI_ENABLE_WPA3_SAE=n
CONFIG_ESP8266_WIFI_NVS_ENABLED=n

CONFIG_LWIP_TCP_SND_BUF_DEFAULT=7300
CONFIG_LWIP_TCP_WND_DEFAULT=7300
CONFIG_LWIP_TCP_MSS=1460
CONFIG_LWIP_TCP_RECVMBOX_SIZE=7
CONFIG_LWIP_TCP_MSL=5000
CONFIG_LWIP_MAX_ACTIVE_TCP=24

CONFIG_TCPIP_ADAPTER_HOSTNAME_MAX_LENGTH=64

CONFIG_ESP_PANIC_PRINT_REBOOT=y

CONFIG_ESP_SYSTEM_EVENT_TASK_STACK_SIZE=1004

CONFIG_ESP_MAIN_TASK_STACK_SIZE=2356

CONFIG_FREERTOS_TIMER_STACKSIZE=476
CONFIG_FREERTOS_IDLE_TASK_STACKSIZE=288

CONFIG_MDNS_TASK_STACK_SIZE=2076

CONFIG_HEAP_PRIO_8BIT_RAM=y
```

## src/Kconfig.projbuild
```kconfig
menu "WiFiSocketServer"

    config TCPIP_ADAPTER_HOSTNAME_MAX_LENGTH
        int "Max hostname length for tcpip adapter"
        range 1 128
        default 64

    config MDNS_TASK_STACK_SIZE
        int "mDNS task stack size"
        default 2076

    config HEAP_PRIO_8BIT_RAM
        bool "Prioritize 8-bit accessible RAM for heap allocation"
        default y

endmenu
```
